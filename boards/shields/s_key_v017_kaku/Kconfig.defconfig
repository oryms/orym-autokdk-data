## boards/shields/s_key_v017_kaku/Kconfig.defconfig
```kconfig
if SHIELD_S_KEY_V017_KAKU_RIGHT

config ZMK_KEYBOARD_NAME
    default "s_key"

endif

if SHIELD_S_KEY_V017_KAKU_LEFT || SHIELD_S_KEY_V017_KAKU_RIGHT

config ZMK_SPLIT
    default y

endif
```

## boards/shields/s_key_v017_kaku/Kconfig.shield
```kconfig
config SHIELD_S_KEY_V017_KAKU_LEFT
    def_bool $(shields_list_contains,s_key_v017_kaku_left)
config SHIELD_S_KEY_V017_KAKU_RIGHT
    def_bool $(shields_list_contains,s_key_v017_kaku_right)
```
